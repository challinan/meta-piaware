## conf/layer.conf
```bitbake
# We have a conf and classes directory, append to BBPATH
BBPATH .= ":${LAYERDIR}"

# We have a recipes directory, add to BBFILES
BBFILES += "${LAYERDIR}/recipes*/*/*.bb ${LAYERDIR}/recipes*/*/*.bbappend ${LAYERDIR}/images/*.bb"

BBFILE_COLLECTIONS += "meta-piaware"
BBFILE_PATTERN_meta-piaware := "^${LAYERDIR}/"
BBFILE_PRIORITY_meta-piaware = "16"

LAYERSERIES_COMPAT_meta-piaware = "sumo"
```
